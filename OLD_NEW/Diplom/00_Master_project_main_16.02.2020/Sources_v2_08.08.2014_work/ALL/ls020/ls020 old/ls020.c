/* ***********************************************************************
**
**  Copyright (C) 2005  Christian Kranz
**
**  Siemens S65 Display Control
**
*********************************************************************** */
// file disp.c
//

#include "ls020.h"
#include "informmodels.h"


//------------------------------------------------------------------------------------------------------
// конcтанты цветов 16-бит
	uint16_t backcolor = black;    								// color of background
	uint16_t textcolor = white;

//------------------------------------------------------------------------------------------------------
// Команды инициализации.
unsigned char init_array_0[24] PROGMEM =
{	0xFD, 0xFD, 0xFD, 0xFD, 0xEF, 0x00, 0xEE, 0x04, 0x1B, 0x04, 0xFE, 0xFE,
 	0xFE, 0xFE, 0xEF, 0x90, 0x4A, 0x04, 0x7F, 0x3F, 0xEE, 0x04, 0x43, 0x06
};

unsigned char init_array_1[46] PROGMEM =
{	0xEF, 0x90, 0x09, 0x83, 0x08, 0x00, 0x0B, 0xAF,
 	0x0A, 0x00, 0x05, 0x00, 0x06, 0x00, 0x07, 0x00, 
 	0xEF, 0x00, 0xEE, 0x0C, 0xEF, 0x90, 0x00, 0x80, 
 	0xEF, 0xB0, 0x49, 0x02, 0xEF, 0x00, 0x7F, 0x01,
 	0xE1, 0x81, 0xE2, 0x02, 0xE2, 0x76, 0xE1, 0x83,
 	0x80, 0x01, 0xEF, 0x90, 0x00, 0x00
};


//------------------------------------------------------------------------------------------------------
// Таблица црифтов для кодировки ASCII символов. Полная таблица символов 256 шт.
// ширина шрифта 6
// высота шрифта 8
unsigned char font6x8[1536] PROGMEM =
{	0x00,0x00,0x00,0x00,0x00,0x00, 		// Symbol 00
 	0x00,0x00,0x00,0x5F,0x00,0x00, 		// Symbol 01
 	0x00,0x00,0x03,0x00,0x03,0x00, 		// Symbol 02
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 	0x00,0x7F,0x7F,0x7F,0x7F,0x7F  		// Symbol FF
};


//------------------------------------------------------------------------------------------------------
// Таблица црифтов для кодировки ASCII символов. Неполная таблица символов - от 32го до 128го.
// ширина шрифта 8
// высота шрифта 14

unsigned char font8x14[1344] PROGMEM =
{
0x00, 0x00, 0x00, 0x00, 0x00, 0x00, 0x00, 0x00, 0x00, 0x00, 0x00, 0x00, 0x00, 0x00, 	// Symbol 20  	space (32)
0x00, 0x00, 0x00, 0x18, 0x3c, 0x3c, 0x3c, 0x18, 0x18, 0x00, 0x18, 0x18, 0x00, 0x00, 	// Symbol 21	!
0x00, 0x66, 0x66, 0x66, 0x24, 0x00, 0x00, 0x00, 0x00, 0x00, 0x00, 0x00, 0x00, 0x00, 	// Symbol 22	"
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0x00, 0x00, 0x00, 0x00, 0x00, 0x10, 0x38, 0x6c, 0xc6, 0xc6, 0xfe, 0x00, 0x00, 0x00
};

//------------------------------------------------------------------------------------------------------
// запись команды 8 бит
void ls020_wrcmd8(char cmd8)									// Запись команды (8бит)
{

  	LS020_PORT_RS |= (1<<LS020_RS);								// Set RS
  	LS020_PORT_CS &= ~(1<<LS020_CS); 							// select LCD											
  	SPDR = cmd8;
  	while ( !(SPSR & (1 << SPIF)));
  	LS020_PORT_CS |= (1<<LS020_CS); 							// deselect LCD

}


//------------------------------------------------------------------------------------------------------
// запись команды 16 бит
void ls020_wrcmd16(uint16_t  cmd16)								// Запись команды (16бит)
{
  	ls020_wrcmd8((cmd16 >> 8) & 0xFF);
  	ls020_wrcmd8(cmd16 & 0xFF);
}


//------------------------------------------------------------------------------------------------------
// запись данных 8 бит
void ls020_wrdata8(char data8)									// Запись данных
{

	LS020_PORT_RS &= ~(1<<LS020_RS); 							// Clear RS
	LS020_PORT_CS &= ~(1<<LS020_CS); 							// select LCD 
  	SPDR = data8;
  	while ( !(SPSR & (1 << SPIF)));
	LS020_PORT_CS |= (1<<LS020_CS); 							// deselect LCD 

}


//------------------------------------------------------------------------------------------------------
// запись данных 16 бит
void ls020_wrdata16(uint16_t data16)
{
  	ls020_wrdata8((data16>>8) & 0xFF);
  	ls020_wrdata8(data16 & 0xFF);
}


//------------------------------------------------------------------------------------------------------
// Инициализация Дисплея
void ls020_init_lcd(void)										// инициализация
{
  	LS020_DDR_RS  |= 1<<LS020_RS;
  	LS020_DDR_RST |= 1<<LS020_RST;
	LS020_DDR_CS  |= 1<<LS020_CS;

  	LS020_PORT_RS  |= 1<<LS020_RS;
  	LS020_PORT_RST |= 1<<LS020_RST;
	LS020_PORT_CS  |= 1<<LS020_CS;
			
	LS020_PORT_RST &= ~(1<<LS020_RST); 							// Pull RST pin down
//  PORTB &= ~(1<<RST); 										// Pull RST pin down
  	_delay_ms(10);

  	LS020_PORT_RST |= (1<<LS020_RST); 							// Release RST pin

  	for (unsigned char i=0; i<24; i++)
    	ls020_wrcmd8(pgm_read_byte(init_array_0+i));
  	_delay_ms(7);
  	for (unsigned char i=0; i<46; i++)
    	ls020_wrcmd8(pgm_read_byte(init_array_1+i));
}


//------------------------------------------------------------------------------------------------------
// заливка полного экрана
void fill_screen(int color, char bits_color)					//	bits_color = 8   - 8  bit mode 
{																//	bits_color = 16  - 16  bit mode 
  	uint16_t i;
  	ls020_wrcmd16(0xEF90);
  	ls020_wrcmd16(0x0500);
  	ls020_wrcmd16(0x0600);
  	ls020_wrcmd16(0x0700);

	switch (bits_color)	
		{
		case 8: 
			ls020_8bit_mode(0); 	
			color &= 0x00FF; 	
			for (i=0; i<DISP_W*DISP_H; i++)
    			ls020_wrdata8(color & 0x00FF);  		
			break;

		case 16: 
			ls020_16bit_mode(); 	
			for (i=0; i<DISP_W*DISP_H; i++)
    			ls020_wrdata16(color); 				
			break;
		}
		
	ls020_8bit_mode(0);											// set 8  bit mode
  	
}


//------------------------------------------------------------------------------------------------------
// Выбор 8-битного режима
// 0 - цветовое пространство RGB
// 1 - цветовое пространство RGB
void ls020_8bit_mode(char BGR) 									// BGR = 0 - disabled, BGR = 1 - enabled.
{
  	ls020_wrcmd16(0xE800+(BGR&0x01)*0x40);
}


// Выбор 16-битного режима
void ls020_16bit_mode(void)										// режим 16 бит
{
  	ls020_wrcmd16(0xE80F);
}


//------------------------------------------------------------------------------------------------------
// Выбор расскладки дисплея
// Direction = 0 - книжная ориентация
// заполнение точек вертикальное, инкримент вертикальной координаты
// Direction = 1 - альбомная ориентация
// заполнение точек вертикальное, инкримент горизонтальной координаты
void Set_Direction(char Direction)								
{
	ls020_wrcmd16(0xEF90);
	ls020_wrcmd16(0x0500 + Direction*0x0004);
}

//------------------------------------------------------------------------------------------------------
// Выбор частичного окна дисплея
// x1,y1 - координаты начальной точки
// x2,y2 - координаты конечной точки
void ls020_set_window(char x1, char y1, char x2,char y2, char Direction)
{	
	Set_Direction(Direction);
  	ls020_wrcmd16(0x0A00 + x1);
  	ls020_wrcmd16(0x0B00 + x2);
  	ls020_wrcmd16(0x0800 + y1);
  	ls020_wrcmd16(0x0900 + y2);
}


//------------------------------------------------------------------------------------------------------
// 0 - normal mode 						- 	книжный режим
// 1 - х-axis symmetry (mirror image) 	- 	симметрия по оси Х (относитально точки x1y1)
// 2 - y-axis symmetry (mirror image) 	- 	симметрия по оси Y (относитально точки x1y1)
// 3 - 180 degree rotation 				- 	разворот на 180 градусов (относитально точки x1y1)
// 4 - mirror image, -90 degree   		- 	разворот на 90 градусов против часовой стрелке 
//											относительно книжной ориентации (относитально точки x1y1)
//											и симметрия о координате У
// 5 - +90 degree 						- 	разворот на 90 градусов по часовой стрелке 
//											относительно книжной ориентации (относитально точки x1y1)
//											альбоная ориентация
// 6 - -90 degree 						- 	разворот на 90 градусов против часовой стрелке 
//											относительно книжной ориентации (относитально точки x1y1)
//											альбоная ориентация перевернутая
// 7 - mirror image, +90 degree 		- 	разворот на 90 градусов по часовой стрелке 
//											относительно книжной ориентации (относитально точки x1y1)
//											и симметрия о координате Х

void rotation(char x, char y, char CHARH, char CHARW, char mode)
{
/*	
	char CHARW = 8;
	char CHARH = 14;
	char x = 20;
	char y = 20;
	
	ls020_16bit_mode();
*/
	
	ls020_wrcmd16(0xEF80);
	ls020_wrcmd16(0x1800 + mode);

	switch(mode)
		{
		case  0:	
//				 	ls020_wrcmd16(0x1800);
					ls020_wrcmd16(ASX + y);
					ls020_wrcmd16(AEX + y + (CHARW - 1));
					ls020_wrcmd16(ASY + x);
					ls020_wrcmd16(AEY + x + (CHARH - 1));
					break;
	
		case  1:	
//				 	ls020_wrcmd16(0x1801);
					ls020_wrcmd16(ASX + y);
					ls020_wrcmd16(AEX + y - (CHARW - 1));
					ls020_wrcmd16(ASY + x);
					ls020_wrcmd16(AEY + x + (CHARH - 1));
					break;
		
		case  2:	
//				 	ls020_wrcmd16(0x1802);
					ls020_wrcmd16(ASX + y);
					ls020_wrcmd16(AEX + y + (CHARW - 1));
					ls020_wrcmd16(ASY + x);
					ls020_wrcmd16(AEY + x - (CHARH - 1));
					break;
		
		case  3:	
//				 	ls020_wrcmd16(0x1803);
					ls020_wrcmd16(ASX + y);
					ls020_wrcmd16(AEX + y - (CHARW - 1));
					ls020_wrcmd16(ASY + x);
					ls020_wrcmd16(AEY + x - (CHARH - 1));
					break;
		
		case  4:	
//				 	ls020_wrcmd16(0x1804);
					ls020_wrcmd16(ASX + y);
					ls020_wrcmd16(AEX + y + (CHARH - 1));
					ls020_wrcmd16(ASY + x);
					ls020_wrcmd16(AEY + x + (CHARW - 1));
					break;
		
		case  5:	
//					ls020_wrcmd16(0x1805);
					ls020_wrcmd16(ASX + y);
					ls020_wrcmd16(AEX + y - (CHARH - 1));
					ls020_wrcmd16(ASY + x);
					ls020_wrcmd16(AEY + x + (CHARW - 1));
					break;

		case  6:	
//					ls020_wrcmd16(0x1806);
					ls020_wrcmd16(ASX + y);
					ls020_wrcmd16(AEX + y - (CHARH - 1));
					ls020_wrcmd16(ASY + x);
					ls020_wrcmd16(AEY + x - (CHARW - 1));
					break;
		
		case  7:	
//					ls020_wrcmd16(0x1807);
					ls020_wrcmd16(ASX + y);
					ls020_wrcmd16(AEX + y - (CHARH - 1));
					ls020_wrcmd16(ASY + x);
					ls020_wrcmd16(AEY + x - (CHARW - 1));
					break;
		}
}


void rotationl(char x, char y, char CHARH, char CHARW, char mode)
{	

/*	
	char CHARW = 8;
	char CHARH = 14;
	char x = 20;
	char y = 20;
*/
	
	ls020_16bit_mode();

	rotation(x, y, CHARH, CHARW, mode);




	
	for (char h=0; h < CHARH; h++) 				// every column of the picture y-direction (mode 0)
		{
		
		uint8_t ch;
		
		ch=(pgm_read_byte(font8x14+14*(0x50-32)+h));

		char mask = 0x80;
		for (char p=0; p < CHAR_W; p++) 		// write the pixels in x direction (mode 0)
			{
			if (ch & mask) 
				{
					ls020_wrdata16(pink);
				}
				else 
				{
					ls020_wrdata16(sky);
				}
			mask = mask/2;
			}		
		}

	ls020_wrcmd16(0x1800);			// нормальный режим вывода
	ls020_8bit_mode(0);


}



//------------------------------------------------------------------------------------------------------
// Вывод cимвола шрифта 8*14
// x - координата по горизонтали в режиме альбом
// у - координата по вертикали в режиме книга
// c - символ в кодировке ASCII
// rot = 1 - режим книга
// rot = 0 - режим альбом перевернутый

void put_char8x14(char x, char y, char symbol, int color, int bkcolor, char bits_color, char rot)
{
  	uint8_t h,ch,p,mask;

	rotation(x, y, 14, 8, rot);

	switch (bits_color)	
		{
		case 8:
			ls020_8bit_mode(0);
  			for (h = 0; h < CHAR_H; h++)									// every column of the character
  				{

       			ch = (pgm_read_byte(font8x14 + 14*(symbol - 32) + h));
				mask = 0x80;
        		for (p = 0; p < CHAR_W; p++)  								// write the pixels
        			{
          			if (ch & mask)
            			ls020_wrdata8(color & 0x00FF);                
          			else
            			ls020_wrdata8(bkcolor & 0x00FF);
					
					mask = mask/2;
					}        		
        		} 
			break;
	
		case 16:
			ls020_16bit_mode();
  			for (h = 0; h < CHAR_H; h++)									// every column of the character
  				{

       			ch = (pgm_read_byte(font8x14 + 14*(symbol - 32) + h));
				mask = 0x80;
        		for (p = 0; p < CHAR_W; p++)  								// write the pixels
        			{
          			if (ch & mask)
            			ls020_wrdata16(color);                
          			else
            			ls020_wrdata16(bkcolor);
          			
					mask = mask/2;
					}
				}
			break;
		} 
  	ls020_8bit_mode(0);
}

//------------------------------------------------------------------------------------------------------
// Вывод cимвола шрифта 6*8
// x - координата по горизонтали в режиме альбом
// у - координата по вертикали в режиме книга
// symbol - символ в кодировке ASCII
// color   - цвет символа 
// bkcolor - цвет фона
void ls020_put_char6x8(char x, char y, char symbol, int color, int bkcolor, char bits_color)
{	
	ls020_set_window(y, x, y + 7, x + 5, 1);
	int offset = 6*(symbol);

	switch (bits_color)	
		{
		case 8: 
			ls020_8bit_mode(0);
			for (char i = 0; i < 6 ; i++)
    			for (char j = 0; j<8; j++)
	  				if (((pgm_read_byte(font6x8 + offset + i) >> j) & 0x01) == 0x01)
	    					ls020_wrdata8(color & 0x00FF);
	  				else
	    					ls020_wrdata8(bkcolor & 0x00FF);		
			break;

		case 16: 
		 	ls020_16bit_mode();
			for (char i = 0; i < 6 ; i++)
    			for (char j = 0; j<8; j++)
	  				if (((pgm_read_byte(font6x8 + offset + i) >> j) & 0x01) == 0x01)
	    					ls020_wrdata16(color);
	  				else
	    					ls020_wrdata16(bkcolor);	
			break;
		
		}
  	ls020_8bit_mode(0);
  	
}

//------------------------------------------------------------------------------------------------------
// Вывод строки символов шрифта 6*8
// x - координата по горизонтали в режиме альбом
// у - координата по вертикали в режиме книга
// text - строка в кодировке ASCII
// color   - цвет символа 
// bkcolor - цвет фона
void ls020_put_string6x8(char x, char y, char * text, int color, int bkcolor, char bits_color)
{
  	unsigned char i=0; 
  	unsigned char x0=0;
  	while (text[i]!=0)
  		{
    	ls020_put_char6x8(x+x0,y,text[i], color,bkcolor, bits_color);
    	i++;
    	x0+=6;
  		}
}

//------------------------------------------------------------------------------------------------------
// Вывод строки символов шрифта 6*8
// x - координата по горизонтали в режиме альбом
// у - координата по вертикали в режиме книга
// text - строка в кодировке ASCII
// color   - цвет символа 
// bkcolor - цвет фона
/*
void ls020_put_string8x14(char x, char y, char * text, int color, int bkcolor, char bits_color)
{
  	unsigned char i=0; 
  	unsigned char x0=0;
  	while (text[i]!=0)
  		{
//		put_char8x14(char x, char y, char symbol, int color, int bkcolor, char bits_color, char rot)
    	ls020_put_char6x8(x+x0,y,text[i], color,bkcolor, bits_color);
    	i++;
    	x0+=6;
  		}
}
*/
//------------------------------------------------------------------------------------------------------
// Вывод прямоугольника заданных размеров и цвета
void ls020_rectangle(char x1, char y1, char x2, char y2, int color, char bits_color)
{	
	ls020_set_window(x1,y1,x2,y2,1);
	switch (bits_color)	
		{
		case 8: 
			ls020_8bit_mode(0);  
			for (char y=y1;y<=y2;y++)
    			for (char x=x1;x<=x2;x++)
    				ls020_wrdata8(color & 0x00FF);		
			break;

		case 16: 
		 	ls020_16bit_mode();
			for (char y=y1;y<=y2;y++)
    			for (char x=x1;x<=x2;x++)
    				ls020_wrdata16(color);
			break;
		
		}
  	ls020_8bit_mode(0);
}



//------------------------------------------------------------------------------------------------------
// Вывод точки заданного цвета
// bits_color = 8  - 8  bit mode
// bits_color = 16 - 16 bit mode
void put_dot(int x, int y, int color, char bits_color)						
{																				
  	ls020_wrcmd16(0xEF90);
  	ls020_wrcmd16(0x0500);
  	ls020_wrcmd16(0x0800 + x);
  	ls020_wrcmd16(0x0A00 + y);
	switch (bits_color)	
		{
		case 8:  ls020_8bit_mode(0); 	ls020_wrdata8(color & 0x00FF); 		break;
		case 16: ls020_16bit_mode(); 	ls020_wrdata16(color); 				break;
		}
		
	ls020_8bit_mode(0);															// set 8  bit mode 

}

void lcd_picture()
{
 	ls020_16bit_mode();
// 	unsigned short i;
 	ls020_wrcmd16(0xEF90);
 	ls020_wrcmd16(0x0500);
 	ls020_wrcmd16(0x0800); //x1
 	ls020_wrcmd16(0x0A00); //y1
 	ls020_wrcmd16(0x0983); //x2
 	ls020_wrcmd16(0x0Baf); //y2
 /*
 	for (i=0; i<(...); i++)
		ls020_wrdata16(pgm_read_word(array+i));
 */
 	ls020_8bit_mode(0);
}



//---------------------------------


// Строит вертикальную линию по координатам у1 - начало линии, у2 - конец линии, 
// х - положение линиии по оси х, 
// color - цвет
// bits_color - кол-во бит цвета (8 или 16)
void line_vertical(char y1, char y2, char x, int color, char bits_color)
{
	ls020_set_window(x, y1, x, y2, 1);
	
	switch (bits_color)	
		{
		case 8:  
				ls020_8bit_mode(0); 	
				for( unsigned i=0; i<(y2-y1); i++)
					{;
					ls020_wrdata8(color & 0x00FF);
					}
			break;
		
		case 16: 
				ls020_16bit_mode(); 	
				for( unsigned i=0; i<(y2-y1); i++)
					{
					ls020_wrdata16(color);
					}
			break;
		}
		
	ls020_8bit_mode(0);	

}

// Строит горизонтальную линию по координатам x1 - начало линии, x2 - конец линии, 
// y - положение линиии по оси y, 
// color - цвет
// bits_color - кол-во бит цвета (8 или 16)
void line_horizontal(char x1, char x2, char y, int color, char bits_color)
{

	ls020_set_window(x1, y, x2, y, 0);
	
	switch (bits_color)	
		{
		case 8:  
				ls020_8bit_mode(0); 	
				for( unsigned i=0; i<(x2-x1); i++)
					{;
					ls020_wrdata8(color & 0x00FF);
					}
			break;
		
		case 16: 
				ls020_16bit_mode(); 	
				for( unsigned i=0; i<(x2-x1); i++)
					{
					ls020_wrdata16(color);
					}
			break;
		}
		
	ls020_8bit_mode(0);	
	 
}

// Строит квадрат(прямоугольник) по двум точк незарисованный внутри
// color - цвет
// bits_color - кол-во бит цвета (8 или 16)
void drawSquare(char x1, char y1, char x2, char y2, int color, char bits_color) 
{
	line_horizontal(x1, x2, y1, color, bits_color);
	line_horizontal(x1, x2, y2, color, bits_color);
	line_vertical(y1, y2, x1, color, bits_color);
	line_vertical(y1, y2, x2, color, bits_color);
}

// Строит линию через две произвольних точки
// не строит вертикальную линию
// color - цвет
// bits_color - кол-во бит цвета (8 или 16)
void drawLine(int x1, int y1, int x2, int y2, int color, char bits_color) 
{
    const int deltaX = abs(x2 - x1);
    const int deltaY = abs(y2 - y1);
    const int signX = x1 < x2 ? 1 : -1;
    const int signY = y1 < y2 ? 1 : -1;
    
    int error = deltaX - deltaY;
    
	put_dot(KoordinaY0 + y2, KoordinaX0 + x2, color, bits_color);
    while(x1 != x2 || y1 != y2) {

		put_dot(KoordinaY0 + y1 ,KoordinaX0 + x1, color, bits_color);
        const int error2 = error * 2;
        
        if(error2 > -deltaY) {
            error -= deltaY;
            x1 += signX;
        }
        if(error2 < deltaX) {
            error += deltaX;
            y1 += signY;
        }
    }
 
}

// Строит круг
// radius - радиус
// color - цвет
// bits_color - кол-во бит цвета (8 или 16)
void drawCircle(int x0, int y0, int radius, int color, char bits_color) 
{
        int x = 0;
        int y = radius;
        int delta = 2 - 2 * radius;
        int error = 0;
        while(y >= 0) {

				put_dot(y0 + y, x0 + x, color, bits_color);
				put_dot(y0 - y, x0 + x, color, bits_color);
				put_dot(y0 + y, x0 - x, color, bits_color);
				put_dot(y0 - y, x0 - x, color, bits_color);
                
				error = 2 * (delta + y) - 1;
                if(delta < 0 && error <= 0) 
					{
                    ++x;
                    delta += 2 * x + 1;
                    continue;
                	}
                error = 2 * (delta - x) - 1;

                if(delta > 0 && error > 0) 
					{
                    --y;
                    delta += 1 - 2 * y;
                    continue;
                	}
                ++x;
                delta += 2 * (x - y);
                --y;
        }
}
 
// Строит круг заполненный внутри
// radius - радиус
// color - цвет
// bits_color - кол-во бит цвета (8 или 16)
void drawCircleFull(int x0, int y0, int radius, int color, char bits_color) 
{
	int i;
	for (i = 0; i < radius + 1; i++)
	drawCircle(x0, y0, i, color, bits_color);

}

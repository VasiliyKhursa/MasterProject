#include "i2c.h"
#include "lcd.h"
#include <avr/io.h>
#include <util/delay.h>



char data [];

//---------------------------------Функции шины---------------------------------//
// Функция инициализация шины TWI
void I2CInit(void)
{
	// настройка TWI модуля 
	TWBR = 2;
	TWSR = (1 << TWPS1)|(1 << TWPS0); // Предделитель на 64
	TWCR |= (1 << TWEN); // Включение модуля TWI
}

void I2CStart(void)
{
	// Передача условия СТАРТ
	TWCR = (1 << TWINT)|(1 << TWEN)|(1 << TWSTA);
	// Ожидание установки флага TWINT
	while(!(TWCR & (1 << TWINT)));
}

void I2CStop(void)
{
	TWCR = (1 << TWINT)|(1 << TWEN)|(1 << TWSTO); // Передача условия СТОП
	while(TWCR & (1 << TWSTO)); // Ожидание завершения передачи условия СТОП
}



// Функция записи данных по шине
uint8_t I2CWriteByte(uint8_t data)
{
	TWDR = data; // Загрузка данных в TWDR	
	TWCR = (1 << TWEN)|(1 << TWINT); // Сброс флага TWINT для начала передачи данных
	while(!(TWCR & (1 << TWINT))); // Ожидание завершения передачи
	// Проверка статуса
	if((TWSR & 0xF8) == 0x18 || (TWSR & 0xF8) == 0x28 || (TWSR & 0xF8) == 0x40)
	{
	// Если адрес DS1307, биты R/W и данные переданы
	// и получено подтверждение
	return 1;
	}
	else
	return 0; // ОШИБКА
}

// Функция чтения данных по шине
uint8_t I2CReadByte(uint8_t *data,uint8_t ack)
{
	if(ack) // Устанавливаем подтверждение
	{
	// Возвращаем подтверждение после приема
	TWCR |= (1 << TWEA);
	}
	else
	{
	// Возвращаем неподтверждение после приема
	// Ведомое устройство не получает больше данных
	// обычно используется для распознования последнего байта
	TWCR &= ~(1 << TWEA);
	}
	// Разрешение приема данных после сброса TWINT
	TWCR |= (1 << TWINT); 
	while(!(TWCR & (1 << TWINT))); // Ожидание установки флага TWINT
	// Проверка статуса
	if((TWSR & 0xF8) == 0x58 || (TWSR & 0xF8) == 0x50)
	{
	// Прием данных и возвращение подтверждения
	//	или
	// Прием данных и возвращение неподтверждения
	*data = TWDR; // Читаем данные
	return 1;
	}
	else
	return 0; // Ошибка	
}

